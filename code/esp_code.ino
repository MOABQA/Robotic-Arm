#include <WiFi.h>
#include <Adafruit_GFX.h>
#include <Adafruit_SSD1306.h>
#include <Wire.h>
#include <U8g2lib.h>
#include <WiFiUdp.h>
#include <ESP32Servo.h>

// Wi-Fi credentials
const char* ssid = "ssid";
const char* password = "password";

// UDP setup
WiFiUDP udp;
const int port = 8080;
char incomingPacket[255];

#define SCREEN_I2C_ADDR 0x3C // or 0x3C
#define SCREEN_WIDTH 128     // OLED display width, in pixels
#define SCREEN_HEIGHT 64     // OLED display height, in pixels
#define OLED_RST_PIN -1      // Reset pin (-1 if not available)

Adafruit_SSD1306 display(128, 64, &Wire, OLED_RST_PIN);

// Pin definitions for buttons
#define BUTTON_UP 14
#define BUTTON_DOWN 12
#define BUTTON_SELECT 2
#define BUTTON_BACK 13 // New back button
const byte PROGMEM frames[][288] = {
 {0,0,0,0,0,0,0,0,0,0,0,0,0,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0,0},
  {0,0,0,0,0,0,0,0,0,0,0,0,0,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0,0},
  {0,0,0,0,0,0,0,0,0,0,0,0,0,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0,0},
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  {0,0,0,0,0,0,0,0,0,0,0,0,0,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0,0}
};

const uint8_t aldo_the_apache_26pt[2338] U8G2_FONT_SECTION("aldo_the_apache_26pt") = 
  "[\0\4\4\5\5\3\6\6\30%\0\372\31\0\33\375\3,\6@\11\5 \6\0\20D\1!\15%"
  "\27<\341\7%\206\314o\37(\42\12J\65f\201\10\376\23\2#>\66\27\304o\20QBD\11\21"
  "%D\224\20QBc\11\15{`\342\301\203V\204\210\22\42J\210(!\242\204H=\60\361\300\304\3"
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  "\250D!e\371\15\0WJ\67\27\324\241\24!U\204\24UQ\246P\211\62\205J\224)D\244\214\221"
  "j\214Tr\244\14\221#eJ\34)Sb\4E%FPTbD\242$\250\220\240:\203\352\314\261"
  "\63\307\316\234\63d\316\220\271R\346J\25,U\10\0X\60\61\27\234\243T\21\63f**S\310\204"
  "\251\22\305J\24[\227\60\313\223(\23\246S\267\254D)\23\206L\30*S\306\22\63FJ\225\60e"
  "\0Y&\60\27\224\301\220\211BE\12\25\261\246H\241\42\205X)\323\16!\226F--[\324h\331"
  "\242F\313\26\65\10\0Z\37-\27\204\201\5\213\7\17\322\231+g\256\234\271r\346\312\231+g\231\71"
  "s\345\36\374\240\0[\17\307\267K\341\203\64\364\377\277y\360\240\0\134\32\310\267Sa\324d\222\215\232"
  "\231\260Q\63\223l\324\314$\33\65\63\311F\15]\17\307\267K\341\203\62\364\377\277y\360 \1^\6"
  "\0\20D\1_\10qT\233\341\7\6`\13\246XO\201\14\21\62\203\6a\24.\27\204g\11\213\7"
  "\37\4\322\217\36\374A!\375Q\1b%/\27\214a\21\233&.\134\24*Q\250D\241\22\205J\24"
  "*\341\242\11\233&\17J\351\325\203\7%\234\264ac\27.\27\204g\11\213\7\37\4\322\227\365#\215"
  "\36|\20\202\311\32\0d\26.\27\204a\15\223\26\17\36\14\322\377\217\36|\20\202\311\32\0e\21,"
  "\27t\341\17\312\325\335\212\275(Ww\17~f\24,\27t'\211\212\7\17\324\325\335\212\275(W\377"
  "\16\0g\22/\27\224\301\205_\24\255\337\360\225\256\36\374A\1h\20.\27\204\241\220\376\243\7\177P"
  "H\377Q\1i\13%\27<\341\323\7\177\240\0j\25-\27|\261\276\7V\260\376P\215\66\17\36\264"
  "X\242\6\0k#/\27\224\241\224\242\22\205J\24*Q\246H\231\42\325\24)S\242P\211B%\12"
  "=\370\203R\372W\5l\15,\27|\241\134\375\377\357\36\374\0m\67\63\27\264\301\34\273V^\275y"
  "\20\346A\230\7a\36\210x\60\342\301\10\27'T\234PqB\305\11%E\224\24QRDI\21\65"
  "c\324\214Q\63F\315\30E\201\12n\32/\27\224\241\324\242\215\330p\323\244\23\27.T\214P\341I"
  "ox\264\253\2o\17/\27\214\341\37\224\322\377\257\36\374A\1p\24.\27\204g\11\213\7\37\4\322"
  "\77z\360\7%\353%\0q\26\257\227\213\207I\213\7\37\220\322\377\257\36\374A\321\262\244\205\7r\36"
  ".\27\214g\11\213\7\37\4\322G\17\376\240\10\231\42uS\242L\211\62%\12iT\0s\26-\27"
  "|\341\17\324hX\360\334u\350\256\63\250F\233\7\77Pt\15/\27\214\341_\25\255\377\377\25\0u"
  "\15.\27\204\241\220\376\377\217\36\374\1v//\27\214\241\20\33\66%\314\24)S\244L\221\62E\312"
  "\24)S\244\210\221\212J\24*Q\250D\241\22\205J\24*Q\250D!e\371\15\0wJ\67\27\324"
  "\241\24!U\204\24UQ\246P\211\62\205J\224)D\244\214\221j\214Tr\244\14\221#eJ\34)"
  "Sb\4E%FPTbD\242$\250\220\240:\203\352\314\261\63\307\316\234\63d\316\220\271R\346J"
  "\25,U\10\0x\60\61\27\234\243T\21\63f**S\310\204\251\22\305J\24[\227\60\313\223(\23"
  "\246S\267\254D)\23\206L\30*S\306\22\63FJ\225\60e\0y&\60\27\224\301\220\211BE\12"
  "\25\261\246H\241\42\205X)\323\16!\226F--[\324h\331\242F\313\26\65\10\0z\37-\27\204"
  "\201\5\213\7\17\322\231+g\256\234\271r\346\312\231+g\231\71s\345\36\374\240\0\0\0\0\4\377\377"
  "\0";
#define FRAME_DELAY (0)
#define FRAME_WIDTH (48)
#define FRAME_HEIGHT (48)
#define FRAME_COUNT (sizeof(frames) / sizeof(frames[0]))

// Servo pins
Servo thumbServo;
Servo indexServo;
Servo middleServo;
Servo ringServo;
Servo pinkyServo;

U8G2_SSD1306_128X64_NONAME_F_HW_I2C u8g2(U8G2_R0, /* reset=*/ U8X8_PIN_NONE); // initialization for the used OLED display
/*
  Fontname: Aldo the Apache
  Copyright: 
  Glyphs: 91/256
  BBX Build Mode: 0
*/



bool connectionHindered = true;

// Menu variables
const char *menuItems[] = {"Gesture Control", "Glove Control", "Credits"};
int currentSelection = 0; // Currently selected menu item
const int menuLength = 3;

volatile bool backButtonPressed = false;  // Flag for interrupt


// Define the MAC address of the receiver ESP32 (replace with actual receiver MAC address)
void IRAM_ATTR backButtonInterrupt() {
  // Set flag to true when the back button is pressed
  backButtonPressed = true;
}

// Setup servos
void setupServos() {
  thumbServo.attach(32);
  indexServo.attach(33);
  middleServo.attach(25);
  ringServo.attach(26);
  pinkyServo.attach(27);
}

void loadingAnimation() {
  // Display loading animation
  int frame = 0;
  while (frame<=25){
  display.clearDisplay();
  display.drawBitmap(40, 8, frames[frame], FRAME_WIDTH, FRAME_HEIGHT, 1);
  display.display();
  frame = (frame + 1) % FRAME_COUNT;
  delay(FRAME_DELAY);
  }
}

void setup(void) {
  Serial.begin(115200);
   // Initialize buttons as inputs
  pinMode(BUTTON_UP, INPUT_PULLDOWN);
  pinMode(BUTTON_DOWN, INPUT_PULLDOWN);
  pinMode(BUTTON_SELECT, INPUT_PULLDOWN);
  pinMode(BUTTON_BACK, INPUT_PULLDOWN); // Initialize back button

  display.begin(SSD1306_SWITCHCAPVCC, SCREEN_I2C_ADDR);
  u8g2.begin(); // start the u8g2 library
  u8g2.clearBuffer();		// clear the internal memory
	u8g2.setFont(aldo_the_apache_26pt); // set custom font
  u8g2.drawStr(10,31,"Robotic"); // print some message
  u8g2.drawStr(30,59,"hand"); // print some message
  Serial.begin(115200);
  attachInterrupt(digitalPinToInterrupt(BUTTON_BACK), backButtonInterrupt, FALLING);  // Trigger on falling edge (button press)
  u8g2.sendBuffer();		// transfer internal memory to the display
  delay(2000);  // one second delay, but we are only displaying a static text, so it makes no difference
  WiFi.begin(ssid, password);
  Serial.println("Initializing ESP-NOW...");
 
  // Connect to Wi-Fi
  while (WiFi.status() != WL_CONNECTED) {
    delay(1000);
    Serial.println("Connecting to WiFi...");
  }
  Serial.println("Connected to WiFi");
 // Start UDP
  udp.begin(port);
  Serial.println("UDP server started");

  // Setup servos
  setupServos();
  loadingAnimation();
  if (!display.begin(SSD1306_SWITCHCAPVCC, 0x3C)) {
    Serial.println(F("SSD1306 allocation failed"));
    for (;;)
      ;
  }
  display.clearDisplay();
  display.display();
  drawMenu();
}


void loop() {
  if (backButtonPressed) {
    backButtonPressed = false; // Reset flag
    drawMenu(); // Return to menu
  }

  // Read button states for other menu navigation
  if (digitalRead(BUTTON_UP) == HIGH) {
    currentSelection--;
    if (currentSelection < 0) currentSelection = menuLength - 1;
    drawMenu();
    delay(200); // Debounce delay
  }

  if (digitalRead(BUTTON_DOWN) == HIGH) {
    currentSelection++;
    if (currentSelection >= menuLength) currentSelection = 0;
    drawMenu();
    delay(200); // Debounce delay
  }

  if (digitalRead(BUTTON_SELECT) == HIGH) {
    // Call the function for the selected menu item
    handleSelection(menuItems[currentSelection]);
  }
}


void drawMenu() {
  display.clearDisplay();

  // Draw notification bar
  display.invertDisplay(false);
  display.fillRect(0, 0, SCREEN_WIDTH, 10, SSD1306_WHITE); // Bar background
  display.setTextColor(SSD1306_BLACK);                    // Text color for the bar
  display.setCursor(50, 1);
  display.setTextSize(1);
  display.println(F("Menu"));

  // Draw menu items
  display.setTextColor(SSD1306_WHITE); // Menu text color
  display.setTextSize(1);
  for (int i = 0; i < menuLength; i++) {
    if (i == currentSelection) {
      // Highlight selected menu item
      display.fillRect(0, 12 + i * 16, SCREEN_WIDTH, 16, SSD1306_WHITE);
      display.setTextColor(SSD1306_BLACK);
    } else {
      display.setTextColor(SSD1306_WHITE);
    }
    display.setCursor(5, 14 + i * 16);
    display.println(menuItems[i]);
  }

  display.display();
}

void handleSelection(const char *selection) {
  if (strcmp(selection, "Gesture Control") == 0) {
    // Clear display and show initial message
    display.clearDisplay();
    display.setTextColor(SSD1306_WHITE);
    display.setTextSize(1);
    display.setCursor(15, 15);
    display.println("Connect your");
    display.setCursor(15, 27);
    display.println("laptop...");
    display.display();
    delay(3000);

    display.clearDisplay();
    display.setTextSize(1);
    display.setCursor(10, 20);
    display.println("Listening...");
    display.display();

    // Continuous UDP packet reading
    while (true) {
      int packetSize = udp.parsePacket();
      if (packetSize) {
        // Read incoming packet
        int len = udp.read(incomingPacket, 255);
        if (len > 0) {
          incomingPacket[len] = '\0'; // Null-terminate the string
        }
        Serial.printf("Received: %s\n", incomingPacket);

        // Parse finger status
        int fingerStates[5];
        int index = 0;
        char* token = strtok(incomingPacket, ",");
        while (index < 5 && token != NULL) {
          fingerStates[index++] = atoi(token);
          token = strtok(NULL, ",");
        }

        // Validate and use parsed data
        if (index == 5) {
          Serial.printf("Parsed angles: %d, %d, %d, %d, %d\n", 
                fingerStates[0], fingerStates[1], fingerStates[2], 
                fingerStates[3], fingerStates[4]);
          thumbServo.write(fingerStates[0]);
          indexServo.write(fingerStates[1]);
          middleServo.write(fingerStates[2]);
          ringServo.write(fingerStates[3]);
          pinkyServo.write(fingerStates[4]);
        } else {
          Serial.println("Error: Incomplete data received.");
        }
      }

      // Check if back button is pressed
      if (backButtonPressed) {
        backButtonPressed = false;  // Reset the flag
        drawMenu(); // Return to menu
        return; // Exit the function early
      }

      delay(50); // Small delay to reduce CPU load
    }
  } 
  else if (strcmp(selection, "Glove Control") == 0) {
    display.clearDisplay();
    display.setTextColor(SSD1306_WHITE);
    display.setCursor(30, 30);
    display.println("Coming Soon");
    display.display();
    delay(1000); // Display message for a while
  } 
  else if (strcmp(selection, "Credits") == 0) {
    display.clearDisplay();
    display.setTextColor(SSD1306_WHITE);
    display.setCursor(10, 20);
    display.println("Developed By:");
    display.setCursor(10, 35);
    display.println("Mohd. Abdul Qadir");
    display.display();
    delay(2000); // Display credits for a while
  }
}


void displayNotification(const char *message) {
  display.clearDisplay();
  display.invertDisplay(false);
  // Draw notification background
  display.fillRect(0, 0, SCREEN_WIDTH, SCREEN_HEIGHT, SSD1306_WHITE);

  // Draw notification text
  display.setTextColor(SSD1306_BLACK);
  display.setTextSize(1);
  display.setCursor(10, SCREEN_HEIGHT / 2 - 6);
  display.println(message);
  display.display(); 
}
